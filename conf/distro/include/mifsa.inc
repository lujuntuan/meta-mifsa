## conf/distro/include/mifsa.inc
```bitbake
require conf/distro/poky.conf

DISTRO_FEATURES_append += "\
    systemd \
"

DISTRO_FEATURES_remove += "\
    sysvinit \
"

PREFERRED_VERSION_openssl = "1.1.%"
PREFERRED_VERSION_openssl-native = "1.1.%"
PREFERRED_VERSION_nativesdk-openssl = "1.1.%"

LICENSE_FLAGS_WHITELIST = "commercial"
VIRTUAL-RUNTIME_init_manager = "systemd"
VIRTUAL-RUNTIME_initscripts = "systemd-compat-units"
DISTRO_FEATURES_BACKFILL_CONSIDERED += "sysvinit"

INHERIT += "extrausers"
EXTRA_USERS_PARAMS = "usermod -P mifsa root;"
hostname_pn-base-files = "mifsa-$MACHINE"
```

## conf/distro/mifsa-sample.conf
```bitbake
require conf/distro/include/mifsa.inc

DISTRO = "mifsa-sample"
DISTRO_NAME = "Mifsa Sample"

DISTRO_FEATURES_remove += "\
    x11 \
    wayland \
    zeroconf \
    ptest \
    3g \
    bluetooth \
    irda \
    nfc \
"
```

## conf/layer.conf
```bitbake
# We have a conf and classes directory, add to BBPATH
BBPATH .= ":${LAYERDIR}"

# We have recipes-* directories, add to BBFILES
BBFILES += "${LAYERDIR}/recipes-*/*/*.bb \
    ${LAYERDIR}/recipes-*/*/*.bbappend"

BBFILE_COLLECTIONS += "mifsa-layer"
BBFILE_PATTERN_mifsa-layer = "^${LAYERDIR}/"
BBFILE_PRIORITY_mifsa-layer = "8"

LAYERVERSION_yocto = "3"
LAYERDEPENDS_yocto = "core openembedded-layer"
LAYERSERIES_COMPAT_mifsa-layer = "sumo thud warrior dunfell hardknott gatesgarth"

MIFSA_LAYERDIR = "${LAYERDIR}"
LICENSE_PATH += "${MIFSA_LAYERDIR}/licenses"
```
